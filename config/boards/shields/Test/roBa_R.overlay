#include "roBa.dtsi"\n#include <dt-bindings/zmk/mouse.h>\n#include <dt-bindings/input/input-event-codes.h>\n\n&default_transform {\n    col-offset = <6>;\n};\n\n&kscan0 {\n    col-gpios\n        = <&xiao_d 10 GPIO_ACTIVE_HIGH>\n        , <&xiao_d 9 GPIO_ACTIVE_HIGH> \n        , <&xiao_d 8 GPIO_ACTIVE_HIGH> \n        , <&xiao_d 7 GPIO_ACTIVE_HIGH> \n        , <&gpio0 10 GPIO_ACTIVE_HIGH>\n        ;\n};\n\n/* トラックボールのリスナー */\n/ {\n    trackball_listener {\n        compatible = "zmk,input-listener";\n        device = <&trackball>;\n    };\n};\n\n&pinctrl {\n    spi0_default: spi0_default {\n        group1 {\n            psels = <NRF_PSEL(SPIM_SCK, 0, 5)>,\n                <NRF_PSEL(SPIM_MOSI, 0, 4)>;\n                /* ★修正箇所: MISOの行を削除しました */\n        };\n    };\n\n    spi0_sleep: spi0_sleep {\n        group1 {\n            psels = <NRF_PSEL(SPIM_SCK, 0, 5)>,\n                <NRF_PSEL(SPIM_MOSI, 0, 4)>;\n                /* ★修正箇所: MISOの行を削除しました */\n            low-power-enable;\n        };\n    };\n};\n\n&xiao_serial { status = "disabled"; };\n\n&spi0 {\n    status = "okay";\n    compatible = "nordic,nrf-spim";\n    pinctrl-0 = <&spi0_default>;\n    pinctrl-1 = <&spi0_sleep>;\n    pinctrl-names = "default", "sleep";\n    cs-gpios = <&gpio0 9 GPIO_ACTIVE_LOW>;\n\n    trackball: trackball@0 {\n        status = "okay";\n        compatible = "pixart,pmw3610";\n        reg = <0>;\n        spi-max-frequency = <2000000>;\n        motion-gpios = <&gpio0 2 (GPIO_ACTIVE_LOW | GPIO_PULL_UP)>;\n        res-cpi = <600>;\n        zephyr,axis-x = <INPUT_REL_X>;\n        zephyr,axis-y = <INPUT_REL_Y>;\n    };\n};
